## CMakeLists.txt
```
# Copyright (c) 2026 Hubble Network, Inc.
# SPDX-License-Identifier: Apache-2.0

cmake_minimum_required(VERSION 3.20.0)
find_package(Zephyr REQUIRED HINTS $ENV{ZEPHYR_BASE})

project(hubble-demo-xg24-dual-stack LANGUAGES C)

target_sources(app PRIVATE
	src/main.c
	src/app_ble.c
	src/board.c
	src/payload.c
)
```

## Kconfig
```
# Copyright (c) 2026 Hubble Network, Inc.
# SPDX-License-Identifier: Apache-2.0

menu "Hubble xG24 dual-stack demo options"

config HUBBLE_DEVICE_KEY
	string "Cryptography key in base64"
	default ""
	help
	  Hubble device's cryptographic key.

config APP_SAT_DEBUG
	bool "Transmit to the satellite 120 s after each beacon period starts"
	help
	  Set the satellite timer to 2 minutes instead of waiting for the
	  next satellite pass overhead. Use this on the bench to check the
	  satellite transmission. Do not deploy a device with this enabled.

config APP_SAT_RETRY_SEC
	int "Retry period after a pass prediction failure, in seconds"
	default 3600
	help
	  If the next satellite pass cannot be computed, the device keeps
	  beaconing and tries again after this period.

endmenu

source "Kconfig.zephyr"

module = APP
module-str = APP
source "subsys/logging/Kconfig.template.log_config"
```

## prj.conf
```kconfig
# Copyright (c) 2026 Hubble Network, Inc.
# SPDX-License-Identifier: Apache-2.0

# Hubble Network
CONFIG_HUBBLE_BLE_NETWORK=y
CONFIG_HUBBLE_SAT_NETWORK=y

# Bluetooth dependencies
CONFIG_BT=y
CONFIG_BT_PERIPHERAL=y
CONFIG_BT_DEVICE_NAME="Hubble-xG24"

# Default BLE Tx power: +8 dBm
CONFIG_BT_CTLR_TX_PWR_ANTENNA=8

# Allow large GATT writes, the orbital params command is 78 bytes
CONFIG_BT_L2CAP_TX_MTU=247
CONFIG_BT_BUF_ACL_RX_SIZE=251
CONFIG_BT_BUF_ACL_TX_SIZE=251

# Used to decode the device key
CONFIG_BASE64=y

# The next satellite pass may be more than 18 hours away
CONFIG_TIMEOUT_64BIT=y

# Used to release the display and turn off the sensor power rail
CONFIG_GPIO=y

CONFIG_LOG=y
CONFIG_MAIN_STACK_SIZE=4096
```

## src/main.c
```c
/*
 * Copyright (c) 2026 Hubble Network, Inc.
 *
 * SPDX-License-Identifier: Apache-2.0
 */

#include <hubble/hubble.h>
#include <hubble/sat/packet.h>
#include <hubble/sat/pass_prediction.h>

#include <zephyr/kernel.h>
#include <zephyr/logging/log.h>
#include <zephyr/sys/base64.h>

#include <stdbool.h>
#include <stdint.h>
#include <string.h>

#include "app_ble.h"
#include "board.h"
#include "payload.h"

LOG_MODULE_REGISTER(main, CONFIG_APP_LOG_LEVEL);

#define HUBBLE_MAX_SAT 6U

struct hubble_sat_orbital_params orb_params[HUBBLE_MAX_SAT];
struct hubble_sat_device_pos device_pos;
uint8_t orb_params_count;
uint64_t unix_time_ms;

/* Hubble device key, decoded from CONFIG_HUBBLE_DEVICE_KEY. */
static uint8_t _hubble_key[CONFIG_HUBBLE_KEY_SIZE];

/* Given by app_ble.c once provisioning (time + orbital params) completes. */
K_SEM_DEFINE(sync_sem, 0, 1);

/* Given by the satellite-pass timer when it is time to transmit. */
static K_SEM_DEFINE(sat_tx_sem, 0, 1);

static void _sat_timer_cb(struct k_timer *timer)
{
	ARG_UNUSED(timer);

	k_sem_give(&sat_tx_sem);
}

static K_TIMER_DEFINE(sat_timer, _sat_timer_cb, NULL);

/*
 * Compute the time until the next satellite pass over the device location.
 * A pass start in the past means we are in the middle of a pass; use the one
 * after it.
 */
static int _next_pass_wait_get(uint64_t *wait_ms)
{
	struct hubble_sat_pass_info pass_info = {0};
	uint64_t now_ms = hubble_time_get();
	int err;

	err = hubble_sat_next_pass_get(now_ms, &device_pos, &pass_info);
	if (err != 0) {
		return err;
	}

	if (pass_info.start <= now_ms) {
		LOG_INF("Pass ongoing or in the past, finding next...");

		err = hubble_sat_next_pass_get(
			pass_info.start + pass_info.duration, &device_pos,
			&pass_info);
		if (err != 0) {
			return err;
		}
	}

	LOG_INF("Next pass at %llu (unix epoch seconds)",
		pass_info.start / MSEC_PER_SEC);
	*wait_ms = pass_info.start - now_ms;

	return 0;
}

/*
 * Satellite packets carry only these payload sizes (see
 * hubble_sat_packet_get()). Any other length is rejected with -EINVAL.
 */
static const uint8_t _sat_payload_sizes[] = {0, 4, 9, 13};

BUILD_ASSERT(APP_PAYLOAD_MAX_LEN <= HUBBLE_SAT_PAYLOAD_MAX);

/* Smallest supported satellite payload size that holds @p len bytes. */
static int _sat_payload_size_get(int len)
{
	for (size_t i = 0; i < ARRAY_SIZE(_sat_payload_sizes); i++) {
		if (len <= _sat_payload_sizes[i]) {
			return _sat_payload_sizes[i];
		}
	}

	return HUBBLE_SAT_PAYLOAD_MAX;
}

static void _sat_transmit(void)
{
	struct hubble_sat_packet packet = {0};
	/* Zeroed, so the bytes after the app payload pad it out. */
	uint8_t payload[HUBBLE_SAT_PAYLOAD_MAX] = {0};
	int payload_len;
	int err;

	payload_len = app_payload_get(payload, sizeof(payload));
	if (payload_len < 0) {
		LOG_ERR("Failed to get payload (err %d)", payload_len);
		return;
	}

	payload_len = _sat_payload_size_get(payload_len);

	err = hubble_sat_packet_get(&packet, payload, payload_len);
	if (err != 0) {
		LOG_ERR("Failed to get sat packet (err %d)", err);
		return;
	}

	LOG_INF("Transmitting to satellite...");
	err = hubble_sat_packet_send(&packet, HUBBLE_SAT_RELIABILITY_NORMAL);
	if (err != 0) {
		LOG_ERR("Failed to send sat packet (err %d)", err);
	}
}

int main(void)
{
	uint64_t wait_ms;
	bool sat_tx;
	int err;

	LOG_INF("Hubble xG24 dual-stack demo started");

	/* Release the display and turn off the sensor rail before anything else. */
	err = board_power_down_peripherals();
	if (err != 0) {
		LOG_WRN("Failed to turn off board peripherals (err %d)", err);
	}

	/* Decode the device key, if one was provided at build time. */
	if (strlen(CONFIG_HUBBLE_DEVICE_KEY) != 0) {
		size_t olen;

		err = base64_decode(_hubble_key, sizeof(_hubble_key), &olen,
				    CONFIG_HUBBLE_DEVICE_KEY,
				    strlen(CONFIG_HUBBLE_DEVICE_KEY));
		if (err != 0) {
			LOG_ERR("Invalid key provided!");
			return -EINVAL;
		}
		if (olen != sizeof(_hubble_key)) {
			LOG_ERR("Key is %zu bytes, expected %zu", olen,
				sizeof(_hubble_key));
			return -EINVAL;
		}
	}

	/*
	 * Enable BLE and start connectable advertising.
	 */
	err = ble_init();
	if (err != 0) {
		LOG_ERR("Failed to init BLE (err %d)", err);
		return err;
	}

	LOG_INF("Waiting for provisioning over BLE...");
	k_sem_take(&sync_sem, K_FOREVER);

	err = hubble_init(unix_time_ms, _hubble_key);
	if (err != 0) {
		LOG_ERR("Failed to initialize Hubble Network (err %d)", err);
		return err;
	}

	err = hubble_sat_satellites_set(orb_params, orb_params_count);
	if (err != 0) {
		LOG_ERR("Failed to set satellite orbital params (err %d)", err);
		return err;
	}

	LOG_INF("Hubble Network initialized with %u satellite(s)",
		orb_params_count);

	/*
	 * From here on, errors skip one satellite transmission instead of
	 * stopping the device, so a demo kit keeps beaconing unattended.
	 */
	for (;;) {
		err = _next_pass_wait_get(&wait_ms);
		sat_tx = (err == 0);
		if (!sat_tx) {
			LOG_ERR("Failed to get next pass info (err %d)", err);
			wait_ms = CONFIG_APP_SAT_RETRY_SEC * MSEC_PER_SEC;
		}

#ifdef CONFIG_APP_SAT_DEBUG
		LOG_INF("Debug mode: next pass in 120 seconds");
		wait_ms = 120 * MSEC_PER_SEC;
		sat_tx = true;
#endif

		k_timer_start(&sat_timer, K_MSEC(wait_ms), K_NO_WAIT);

		err = ble_adv_start();
		if (err != 0) {
			LOG_ERR("Failed to start beacon adv (err %d)", err);
		} else {
			LOG_INF("Beaconing until next pass...");
		}

		k_sem_take(&sat_tx_sem, K_FOREVER);

		/* Stop the beacon and transmit to the satellite. */
		err = ble_adv_stop();
		if (err != 0) {
			LOG_ERR("Failed to stop beacon adv (err %d)", err);
			continue;
		}

		if (sat_tx) {
			_sat_transmit();
		}
	}

	return 0;
}
```

## src/app_ble.c
```c
/*
 * Copyright (c) 2026 Hubble Network, Inc.
 *
 * SPDX-License-Identifier: Apache-2.0
 */

#include <hubble/hubble.h>
#include <hubble/ble.h>
#include <hubble/sat/pass_prediction.h>

#include <zephyr/kernel.h>
#include <zephyr/bluetooth/bluetooth.h>
#include <zephyr/bluetooth/conn.h>
#include <zephyr/bluetooth/gatt.h>
#include <zephyr/bluetooth/uuid.h>
#include <zephyr/logging/log.h>
#include <zephyr/sys/byteorder.h>

#include <stdint.h>
#include <string.h>

#include "app_ble.h"
#include "payload.h"

LOG_MODULE_REGISTER(app_ble, CONFIG_APP_LOG_LEVEL);

/*
 * 0xFCA7 is the UUID advertised while the device is connectable and waiting to
 * be provisioned. It distinguishes a device that still needs time / orbital
 * parameters from one that is properly beaconing the Hubble UUID (0xFCA6).
 */
#define HUBBLE_BLE_UUID_PROVISION      0xFCA7

/* Buffer used for the Hubble beacon advertisement payload. */
#define HUBBLE_BLE_BUFFER_LEN          31U

#define HUBBLE_CMD                     0x01
#define HUBBLE_CMD_UNIX_EPOCH          0x02
#define HUBBLE_CMD_ORBITAL_PARAMS      0x03
#define HUBBLE_CMD_DEVICE_LOCATION     0x04
#define HUBBLE_ORBITAL_PARAMS_CMD_SIZE 76U
#define HUBBLE_MAX_SAT                 6U

/* Period to refresh the beacon advertisement payload with a new reading. */
#define HUBBLE_ADV_REFRESH_PERIOD      K_SECONDS(300)

/* Converts milliseconds to advertising interval units of 0.625 ms. */
#define MS_TO_ADV_INTERVAL(_ms)        ((_ms) * 1000U / 625U)

#define ADV_INTERVAL_MS                1500U

/*
 *   Service:        0000fca7-0000-1000-8000-00805f9b34fb
 *   Characteristic: 00000005-fca7-4000-8000-00805f9b34fb
 */
#define HUBBLE_PROV_SVC_UUID                                                   \
	BT_UUID_DECLARE_128(BT_UUID_128_ENCODE(0x0000fca7, 0x0000, 0x1000,     \
					       0x8000, 0x00805f9b34fb))
#define HUBBLE_PROV_CHR_UUID                                                   \
	BT_UUID_DECLARE_128(BT_UUID_128_ENCODE(0x00000005, 0xfca7, 0x4000,     \
					       0x8000, 0x00805f9b34fb))

/*
 * Provisioning data lives in main.c
 */
extern struct hubble_sat_orbital_params orb_params[];
extern struct hubble_sat_device_pos device_pos;
extern uint8_t orb_params_count;
extern uint64_t unix_time_ms;

/* Given once provisioning completes (time received and peer disconnected). */
extern struct k_sem sync_sem;

/* Hubble beacon advertisement state. */
static uint16_t _beacon_uuid = HUBBLE_BLE_UUID;
static uint8_t _beacon_buffer[HUBBLE_BLE_BUFFER_LEN];
static struct bt_data _beacon_ad[] = {
	BT_DATA(BT_DATA_UUID16_ALL, &_beacon_uuid, sizeof(_beacon_uuid)),
	/* svc data, set at runtime in _beacon_data_update() */
	BT_DATA(BT_DATA_SVC_DATA16, _beacon_buffer, sizeof(_beacon_buffer)),
};

/* Connectable provisioning advertisement. */
static const struct bt_data _prov_ad[] = {
	BT_DATA_BYTES(BT_DATA_UUID16_ALL,
		      BT_UUID_16_ENCODE(HUBBLE_BLE_UUID_PROVISION)),
	BT_DATA(BT_DATA_NAME_COMPLETE, CONFIG_BT_DEVICE_NAME,
		sizeof(CONFIG_BT_DEVICE_NAME) - 1),
};

/* Fetch a fresh Hubble beacon payload into the advertisement data set. */
static int _beacon_data_update(void)
{
	uint8_t payload[APP_PAYLOAD_MAX_LEN];
	int payload_len;
	size_t out_len = sizeof(_beacon_buffer);
	int err;

	payload_len = app_payload_get(payload, sizeof(payload));
	if (payload_len < 0) {
		LOG_ERR("Failed to get payload (err=%d)", payload_len);
		return payload_len;
	}

	memset(_beacon_buffer, 0, sizeof(_beacon_buffer));
	err = hubble_ble_advertise_get(payload, payload_len, _beacon_buffer,
				       &out_len);
	if (err != 0) {
		LOG_ERR("Failed to get Hubble adv data (err=%d)", err);
		return err;
	}

	_beacon_ad[1].data_len = out_len;

	return 0;
}

static void _adv_refresh_work_handler(struct k_work *work)
{
	ARG_UNUSED(work);

	if (_beacon_data_update() != 0) {
		return;
	}

	(void)bt_le_adv_update_data(_beacon_ad, ARRAY_SIZE(_beacon_ad), NULL, 0);
}

static K_WORK_DEFINE(_adv_refresh_work, _adv_refresh_work_handler);

static void _adv_refresh_timer_cb(struct k_timer *timer)
{
	ARG_UNUSED(timer);

	k_work_submit(&_adv_refresh_work);
}

static K_TIMER_DEFINE(_adv_refresh_timer, _adv_refresh_timer_cb, NULL);

int ble_adv_start(void)
{
	int err;

	if (!bt_is_ready()) {
		err = bt_enable(NULL);
		if (err != 0) {
			return err;
		}
	}

	err = _beacon_data_update();
	if (err != 0) {
		return err;
	}
	LOG_DBG("Beacon advertisement payload: %d bytes", _beacon_ad[1].data_len);

	err = bt_le_adv_start(
		BT_LE_ADV_PARAM(BT_LE_ADV_OPT_USE_NRPA,
				MS_TO_ADV_INTERVAL(ADV_INTERVAL_MS),
				MS_TO_ADV_INTERVAL(ADV_INTERVAL_MS), NULL),
		_beacon_ad, ARRAY_SIZE(_beacon_ad), NULL, 0);
	if (err != 0) {
		LOG_ERR("Failed to start beacon adv (err=%d)", err);
		return err;
	}

	k_timer_start(&_adv_refresh_timer, HUBBLE_ADV_REFRESH_PERIOD,
		      HUBBLE_ADV_REFRESH_PERIOD);

	return 0;
}

int ble_adv_stop(void)
{
	k_timer_stop(&_adv_refresh_timer);
	bt_le_adv_stop();
	return bt_disable();
}

static ssize_t _prov_write(struct bt_conn *conn,
			   const struct bt_gatt_attr *attr, const void *buf,
			   uint16_t len, uint16_t offset, uint8_t flags)
{
	const uint8_t *data = buf;

	ARG_UNUSED(conn);
	ARG_UNUSED(attr);
	ARG_UNUSED(flags);

	if (offset != 0) {
		return BT_GATT_ERR(BT_ATT_ERR_INVALID_OFFSET);
	}

	if (len < 2 || data[0] != HUBBLE_CMD) {
		return BT_GATT_ERR(BT_ATT_ERR_NOT_SUPPORTED);
	}

	switch (data[1]) {
	case HUBBLE_CMD_UNIX_EPOCH:
		if (len != (2 + sizeof(uint64_t))) {
			return BT_GATT_ERR(BT_ATT_ERR_INVALID_ATTRIBUTE_LEN);
		}

		memcpy(&unix_time_ms, &data[2], sizeof(unix_time_ms));
		LOG_INF("Received unix time: %llu", unix_time_ms);
		break;

	case HUBBLE_CMD_ORBITAL_PARAMS:
		struct hubble_sat_orbital_params *dst;
		const uint8_t *p = &data[2];

		if (len != (2 + HUBBLE_ORBITAL_PARAMS_CMD_SIZE)) {
			return BT_GATT_ERR(BT_ATT_ERR_INVALID_ATTRIBUTE_LEN);
		}

		if (orb_params_count >= HUBBLE_MAX_SAT) {
			LOG_WRN("Max satellite count reached, ignoring params");
			break;
		}

		dst = &orb_params[orb_params_count];

		/* Copy field by field to avoid alignment issues. */
		memcpy(&dst->t0, p, sizeof(uint64_t));
		memcpy(&dst->n0, p + 8, sizeof(double));
		memcpy(&dst->ndot, p + 16, sizeof(double));
		memcpy(&dst->raan0, p + 24, sizeof(double));
		memcpy(&dst->raandot, p + 32, sizeof(double));
		memcpy(&dst->aop0, p + 40, sizeof(double));
		memcpy(&dst->aopdot, p + 48, sizeof(double));
		memcpy(&dst->inclination, p + 56, sizeof(double));
		memcpy(&dst->eccentricity, p + 64, sizeof(double));
		memcpy(&dst->satellite_id, p + 72, sizeof(uint32_t));

		orb_params_count++;
		LOG_INF("Received orbital params for satellite ID %u",
			dst->satellite_id);
		break;

	case HUBBLE_CMD_DEVICE_LOCATION:
		if (len != (2 + 2 * sizeof(double))) {
			return BT_GATT_ERR(BT_ATT_ERR_INVALID_ATTRIBUTE_LEN);
		}
		memcpy(&device_pos.lat, &data[2], sizeof(double));
		memcpy(&device_pos.lon, &data[2] + sizeof(double),
		       sizeof(double));
		break;
	default:
		return BT_GATT_ERR(BT_ATT_ERR_NOT_SUPPORTED);
	}

	return len;
}

/* Provisioning GATT service. */
BT_GATT_SERVICE_DEFINE(
	hubble_prov_svc, BT_GATT_PRIMARY_SERVICE(HUBBLE_PROV_SVC_UUID),
	BT_GATT_CHARACTERISTIC(HUBBLE_PROV_CHR_UUID,
			       BT_GATT_CHRC_WRITE | BT_GATT_CHRC_WRITE_WITHOUT_RESP,
			       BT_GATT_PERM_WRITE, NULL, _prov_write, NULL), );

static int _start_provisioning_adv(void)
{
	int err;

	err = bt_le_adv_start(
		BT_LE_ADV_PARAM(BT_LE_ADV_OPT_USE_NRPA | BT_LE_ADV_OPT_CONN,
				BT_GAP_ADV_FAST_INT_MIN_2,
				BT_GAP_ADV_FAST_INT_MAX_2, NULL),
		_prov_ad, ARRAY_SIZE(_prov_ad), NULL, 0);
	if (err != 0) {
		LOG_ERR("Failed to start provisioning adv (err=%d)", err);
	}

	return err;
}

static void _prov_restart_work_handler(struct k_work *work)
{
	ARG_UNUSED(work);

	(void)_start_provisioning_adv();
}

static K_WORK_DEFINE(_prov_restart_work, _prov_restart_work_handler);

static void _connected(struct bt_conn *conn, uint8_t err)
{
	ARG_UNUSED(conn);

	if (err != 0) {
		LOG_WRN("Connection failed (err 0x%02x), restarting adv", err);
		k_work_submit(&_prov_restart_work);
		return;
	}

	LOG_DBG("Connected, waiting for provisioning data");
}

static void _disconnected(struct bt_conn *conn, uint8_t reason)
{
	ARG_UNUSED(conn);

	LOG_DBG("Disconnected (reason 0x%02x)", reason);

	if (unix_time_ms != 0U) {
		k_sem_give(&sync_sem);
	} else {
		k_work_submit(&_prov_restart_work);
	}
}

BT_CONN_CB_DEFINE(conn_callbacks) = {
	.connected = _connected,
	.disconnected = _disconnected,
};

int ble_init(void)
{
	int err;

	err = bt_enable(NULL);
	if (err != 0) {
		LOG_ERR("Bluetooth init failed (err %d)", err);
		return err;
	}

	return _start_provisioning_adv();
}
```

## src/app_ble.h
```c
/*
 * Copyright (c) 2026 Hubble Network, Inc.
 *
 * SPDX-License-Identifier: Apache-2.0
 */

#ifndef APP_BLE_H
#define APP_BLE_H

/**
 * @brief Initialize the Bluetooth LE subsystem.
 *
 * Enables the Bluetooth stack, and starts a connectable
 * advertising session that exposes the Hubble provisioning GATT service.
 * Must be called once before any other BLE function.
 *
 * Provisioning data (UTC time and satellite orbital parameters) received over
 * GATT is stored in the @c unix_time_ms / @c orb_params globals owned by the
 * application. Once a peer has written the time and disconnects, @c sync_sem
 * is given so the application can proceed.
 *
 * @return 0 on success, negative errno on failure.
 */
int ble_init(void);

/**
 * @brief Start the Hubble terrestrial beacon advertising.
 *
 * Begins broadcasting non-connectable Hubble beacon packets that carry the
 * application payload. The payload is rebuilt from a new sensor reading every
 * HUBBLE_ADV_REFRESH_PERIOD seconds. @ref ble_init must have been called
 * successfully before invoking this function.
 *
 * @return 0 on success, negative errno on failure.
 */
int ble_adv_start(void);

/**
 * @brief Stop the Hubble terrestrial beacon advertising.
 *
 * Stop advertisements and the payload refresh timer. Safe to call even
 * if advertising is already stopped.
 *
 * @return 0 on success, negative errno on failure.
 */
int ble_adv_stop(void);

#endif /* APP_BLE_H */
```

## src/board.c
```c
/*
 * Copyright (c) 2026 Hubble Network, Inc.
 *
 * SPDX-License-Identifier: Apache-2.0
 */

#include <zephyr/devicetree.h>
#include <zephyr/drivers/gpio.h>
#include <zephyr/drivers/spi.h>
#include <zephyr/logging/log.h>

#include <em_device.h>

#include "board.h"

LOG_MODULE_REGISTER(board, CONFIG_APP_LOG_LEVEL);

/*
 * The display is a Sharp LS013B7DH03 memory LCD on EUSART1. The app does not
 * enable the display driver, so these pins stay in their reset state unless
 * they are driven here:
 *   disp-en   - display ownership (PC9)
 *   extcomin  - VCOM toggle input (PC6)
 *   cs-gpios  - chip select, active high (PC8)
 *
 * The display is shared with the kit's board controller. Driving disp-en low
 * gives it to the board controller and powers it from the board controller's
 * rail, not VMCU (UG573). On USB power the board controller shows its own
 * screen. On battery the board controller is unpowered, so the display is
 * blank and draws nothing. Keeping it blank on USB would mean taking the
 * display and pulsing EXTCOMIN at 54-65 Hz from VMCU, which costs battery.
 */
#define DISPLAY_NODE   DT_NODELABEL(ls0xx_ls013b7dh03)

/* Power rail of the Si7021 (PD3). The app uses the die sensor instead. */
#define SENSOR_EN_NODE DT_NODELABEL(sensor_enable)

BUILD_ASSERT(DT_NODE_EXISTS(DISPLAY_NODE) && DT_NODE_EXISTS(SENSOR_EN_NODE),
	     "This app targets the xG24 Pro Kit (xg24_rb4187c)");

static const struct gpio_dt_spec _off_pins[] = {
	GPIO_DT_SPEC_GET(DISPLAY_NODE, disp_en_gpios),
	GPIO_DT_SPEC_GET(DISPLAY_NODE, extcomin_gpios),
	SPI_CS_GPIOS_DT_SPEC_GET(DISPLAY_NODE),
	GPIO_DT_SPEC_GET(SENSOR_EN_NODE, enable_gpios),
};

/* 0 degrees Celsius in hundredths of a Kelvin. */
#define ZERO_C_IN_CENTI_K 27315

int board_power_down_peripherals(void)
{
	int err;

	for (size_t i = 0; i < ARRAY_SIZE(_off_pins); i++) {
		if (!gpio_is_ready_dt(&_off_pins[i])) {
			return -ENODEV;
		}

		err = gpio_pin_configure_dt(&_off_pins[i], GPIO_OUTPUT_INACTIVE);
		if (err != 0) {
			LOG_ERR("Failed to drive pin %u low (err %d)",
				_off_pins[i].pin, err);
			return err;
		}
	}

	LOG_INF("Display released, sensor rail off");

	return 0;
}

int16_t board_temperature_get(void)
{
	/*
	 * EMU_TEMP holds the last hardware sample in quarter-Kelvin: integer
	 * Kelvin in TEMP, the fraction in TEMPLSB. 0.25 K is 25 centi-K.
	 */
	uint32_t quarter_k =
		(EMU->TEMP & (_EMU_TEMP_TEMP_MASK | _EMU_TEMP_TEMPLSB_MASK)) >>
		_EMU_TEMP_TEMPLSB_SHIFT;

	return (int16_t)((int32_t)quarter_k * 25 - ZERO_C_IN_CENTI_K);
}
```

## src/board.h
```c
/*
 * Copyright (c) 2026 Hubble Network, Inc.
 *
 * SPDX-License-Identifier: Apache-2.0
 */

#ifndef BOARD_H
#define BOARD_H

#include <stdint.h>

/**
 * @brief Turn off the board peripherals that the demo does not use.
 *
 * Releases the Sharp memory LCD to the kit's board controller and turns off
 * the power rail of the Si7021 sensor on the xG24 Pro Kit mainboard. On
 * battery power the LCD is then blank; on USB power the board controller
 * draws its own screen. Call once at boot, before Bluetooth starts.
 *
 * @return 0 on success, negative errno on failure.
 */
int board_power_down_peripherals(void);

/**
 * @brief Read the EFR32 die temperature.
 *
 * The EMU samples the on-chip temperature sensor in hardware, so a read does
 * not wake anything or draw extra current.
 *
 * @return Temperature in hundredths of a degree Celsius.
 */
int16_t board_temperature_get(void);

#endif /* BOARD_H */
```

## src/payload.c
```c
/*
 * Copyright (c) 2026 Hubble Network, Inc.
 *
 * SPDX-License-Identifier: Apache-2.0
 */

#include <hubble/ble.h>
#include <hubble/sat/packet.h>

#include <errno.h>

#include <zephyr/logging/log.h>
#include <zephyr/sys/byteorder.h>

#include "board.h"
#include "payload.h"

LOG_MODULE_REGISTER(payload, CONFIG_APP_LOG_LEVEL);

/*
 * Type byte from the Hubble Dash sensor widget registry. The registry fixes
 * the value type and scale for each entry, see
 * https://hubble.com/docs/guides/dashboard/sensor-widget
 */
#define PAYLOAD_TYPE_TEMPERATURE_HIGH_RES 0x01U

BUILD_ASSERT(APP_PAYLOAD_MAX_LEN <= HUBBLE_BLE_MAX_DATA_LEN);
BUILD_ASSERT(APP_PAYLOAD_MAX_LEN <= HUBBLE_SAT_PAYLOAD_MAX);

int app_payload_get(uint8_t *buf, size_t len)
{
	int16_t centi_c;
	int32_t magnitude;

	if (len < APP_PAYLOAD_MAX_LEN) {
		return -EINVAL;
	}

	centi_c = board_temperature_get();

	buf[0] = PAYLOAD_TYPE_TEMPERATURE_HIGH_RES;
	sys_put_le16((uint16_t)centi_c, &buf[1]);

	magnitude = (centi_c < 0) ? -(int32_t)centi_c : centi_c;
	LOG_INF("Temperature: %s%d.%02d C", (centi_c < 0) ? "-" : "",
		magnitude / 100, magnitude % 100);

	return APP_PAYLOAD_MAX_LEN;
}
```

## src/payload.h
```c
/*
 * Copyright (c) 2026 Hubble Network, Inc.
 *
 * SPDX-License-Identifier: Apache-2.0
 */

#ifndef PAYLOAD_H
#define PAYLOAD_H

#include <stddef.h>
#include <stdint.h>

/** Largest payload app_payload_get() writes, in bytes. */
#define APP_PAYLOAD_MAX_LEN 3U

/**
 * @brief Build the application payload from a fresh sensor reading.
 *
 * The same payload goes in the BLE beacon and in the satellite packet. The
 * layout follows the Hubble Dash sensor widget:
 *
 * @code
 * offset  size  field
 *   0      1    type: 0x01, Temperature High Res
 *   1      2    temperature, int16 little-endian, 0.01 degC
 * @endcode
 *
 * Satellite packets carry only 0, 4, 9 or 13 payload bytes, so the satellite
 * path in main.c zero-pads this payload to 4 bytes. The BLE beacon carries it
 * as is.
 *
 * @param buf Output buffer.
 * @param len Size of @p buf, at least @ref APP_PAYLOAD_MAX_LEN.
 *
 * @return Number of bytes written, or -EINVAL if @p buf is too small.
 */
int app_payload_get(uint8_t *buf, size_t len);

#endif /* PAYLOAD_H */
```
